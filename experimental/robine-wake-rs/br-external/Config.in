## experimental/robine-wake-rs/br-external/Config.in
```kconfig
source "$BR2_EXTERNAL_ROBINE_PATH/package/robine-fwup/Config.in"
source "$BR2_EXTERNAL_ROBINE_PATH/package/robine-wake/Config.in"
```

## experimental/robine-wake-rs/br-external/configs/robine_qemu_defconfig
```kconfig
# Robine Wake 2 — QEMU virt aarch64 (QA-003)
BR2_aarch64=y
BR2_cortex_a53=y
BR2_TOOLCHAIN_EXTERNAL=y
BR2_TOOLCHAIN_EXTERNAL_BOOTLIN=y
BR2_TOOLCHAIN_EXTERNAL_BOOTLIN_AARCH64_MUSL_STABLE=y
BR2_GLOBAL_PATCH_DIR="board/qemu/patches"
BR2_TARGET_GENERIC_HOSTNAME="robine-wake"
BR2_TARGET_GENERIC_ISSUE="Robine Wake 2"
BR2_ROOTFS_DEVICE_CREATION_DYNAMIC_MDEV=y
# BR2_TARGET_GENERIC_REMOUNT_ROOTFS_RW is not set
BR2_ROOTFS_OVERLAY="$(BR2_EXTERNAL_ROBINE_PATH)/board/common/rootfs_overlay"
BR2_ROOTFS_POST_BUILD_SCRIPT="$(BR2_EXTERNAL_ROBINE_PATH)/board/common/post-build.sh"
BR2_ROOTFS_POST_IMAGE_SCRIPT="$(BR2_EXTERNAL_ROBINE_PATH)/board/qemu-aarch64/post-image.sh"
BR2_LINUX_KERNEL=y
BR2_LINUX_KERNEL_CUSTOM_VERSION=y
BR2_LINUX_KERNEL_CUSTOM_VERSION_VALUE="6.18.7"
BR2_LINUX_KERNEL_USE_CUSTOM_CONFIG=y
BR2_LINUX_KERNEL_CUSTOM_CONFIG_FILE="board/qemu/aarch64-virt/linux.config"
BR2_LINUX_KERNEL_CONFIG_FRAGMENT_FILES="$(BR2_EXTERNAL_ROBINE_PATH)/board/qemu-aarch64/linux.fragment"
BR2_LINUX_KERNEL_NEEDS_HOST_OPENSSL=y
BR2_PACKAGE_BUSYBOX_CONFIG_FRAGMENT_FILES="$(BR2_EXTERNAL_ROBINE_PATH)/board/common/busybox.fragment"
BR2_PACKAGE_E2FSPROGS=y
# BR2_PACKAGE_E2FSPROGS_FSCK is not set
BR2_PACKAGE_DROPBEAR=y
# BR2_PACKAGE_DROPBEAR_CLIENT is not set
BR2_PACKAGE_ROBINE_WAKE=y
BR2_PACKAGE_ROBINE_WAKE_DEV_MODE=y
BR2_TARGET_ROOTFS_SQUASHFS=y
BR2_TARGET_ROOTFS_SQUASHFS4_XZ=y
# BR2_TARGET_ROOTFS_TAR is not set
BR2_PACKAGE_HOST_E2FSPROGS=y
BR2_PACKAGE_HOST_GENIMAGE=y
BR2_PACKAGE_HOST_QEMU=y
BR2_PACKAGE_HOST_QEMU_SYSTEM_MODE=y
```

## experimental/robine-wake-rs/br-external/package/robine-fwup/Config.in
```kconfig
config BR2_PACKAGE_ROBINE_FWUP
	bool "robine-fwup"
	depends on BR2_USE_MMU
	depends on BR2_USE_WCHAR
	depends on !BR2_PACKAGE_FWUP
	select BR2_PACKAGE_LIBARCHIVE
	select BR2_PACKAGE_ZLIB
	select BR2_PACKAGE_LIBCONFUSE
	help
	  fwup on the device, newer than Buildroot's (1.9.1), which
	  lacks MBR logical partitions needed by the A/B layout
	  (OPS-001). Installs /usr/bin/fwup.

	  https://github.com/fwup-home/fwup

config BR2_PACKAGE_HOST_ROBINE_FWUP
	bool "host robine-fwup"
	depends on !BR2_PACKAGE_HOST_FWUP
	help
	  fwup on the build host, to create and sign robine-wake.fw.
```

## experimental/robine-wake-rs/br-external/package/robine-wake/Config.in
```kconfig
config BR2_PACKAGE_ROBINE_WAKE
	bool "robine-wake"
	depends on BR2_aarch64 || BR2_arm
	help
	  Robine Wake 2 device daemon, its web bundle and its runit
	  service.

	  The daemon is a static musl binary built outside Buildroot by
	  the top-level Makefile with the pinned Rust toolchain
	  (rust-toolchain.toml): Buildroot's own rustc is older than the
	  daemon's dependencies require. This package installs the
	  staged distribution directory.

if BR2_PACKAGE_ROBINE_WAKE

config BR2_PACKAGE_ROBINE_WAKE_DIST_DIR
	string "distribution directory"
	default "$(BR2_EXTERNAL_ROBINE_PATH)/../output/dist"
	help
	  Directory staged by `make dist`: bin/robine-wake, web/,
	  optional sounds/ and authorized_keys.

config BR2_PACKAGE_ROBINE_WAKE_DEV_MODE
	bool "development mode"
	help
	  Lets the service run /data/dev/robine-wake when
	  /data/dev/enabled exists (`make deploy`). Never enable it in
	  a production image (OPS-002.4).

endif
```

## nerves_system_rpi0/package/bluez-alsa5/Config.in
```kconfig
config BR2_PACKAGE_BLUEZ_ALSA5
	bool "bluez-alsa5"
	depends on !BR2_PACKAGE_BLUEZ_ALSA
	depends on !BR2_STATIC_LIBS # bluez5
	depends on BR2_TOOLCHAIN_HAS_THREADS_NPTL
	depends on BR2_USE_MMU # bluez5 -> dbus
	depends on BR2_USE_WCHAR # libglib2
	select BR2_PACKAGE_ALSA_LIB
	select BR2_PACKAGE_ALSA_LIB_MIXER
	select BR2_PACKAGE_BLUEZ5_UTILS
	select BR2_PACKAGE_BLUEZ5_UTILS_PLUGINS_AUDIO
	select BR2_PACKAGE_LIBGLIB2
	select BR2_PACKAGE_SBC
	help
	  Bluetooth Audio ALSA Backend, release 5.

	  Buildroot ships 4.3.1; release 5 adds A2DP sink delay
	  reporting, which lets the phone keep video in sync.

	  https://github.com/arkq/bluez-alsa
```

## nerves_system_rpi3/package/nqptp8/Config.in
```kconfig
config BR2_PACKAGE_NQPTP8
	bool "nqptp8"
	depends on !BR2_PACKAGE_NQPTP
	depends on BR2_USE_MMU
	depends on BR2_TOOLCHAIN_HAS_THREADS
	select BR2_PACKAGE_LIBCONFIG
	help
	  NQPTP 1.2.8, the PTP timing companion of Shairport Sync 5.

	  Buildroot ships 1.2.4; Shairport Sync 5.5 passes activity
	  information to NQPTP and its release notes ask for NQPTP to
	  be updated alongside it.

	  https://github.com/mikebrady/nqptp
```

## nerves_system_rpi3/package/shairport-sync5/Config.in
```kconfig
config BR2_PACKAGE_SHAIRPORT_SYNC5
	bool "shairport-sync5"
	depends on !BR2_PACKAGE_SHAIRPORT_SYNC
	depends on BR2_TOOLCHAIN_HAS_THREADS_NPTL
	depends on BR2_INSTALL_LIBSTDCPP
	depends on BR2_USE_MMU # nqptp, avahi
	depends on !BR2_STATIC_LIBS # avahi
	depends on BR2_PACKAGE_LIBGPG_ERROR_ARCH_SUPPORTS # libgcrypt
	depends on BR2_PACKAGE_FFMPEG_ARCH_SUPPORTS
	select BR2_PACKAGE_ALSA_LIB
	select BR2_PACKAGE_ALSA_LIB_MIXER
	select BR2_PACKAGE_LIBCONFIG
	select BR2_PACKAGE_OPENSSL
	select BR2_PACKAGE_POPT
	select BR2_PACKAGE_AVAHI
	select BR2_PACKAGE_AVAHI_DAEMON
	select BR2_PACKAGE_NQPTP8 # runtime
	select BR2_PACKAGE_LIBPLIST
	select BR2_PACKAGE_LIBSODIUM
	select BR2_PACKAGE_LIBGCRYPT
	select BR2_PACKAGE_FFMPEG
	select BR2_PACKAGE_UTIL_LINUX
	select BR2_PACKAGE_UTIL_LINUX_LIBUUID
	help
	  Shairport Sync, release 5, built for AirPlay 2 with Avahi
	  and FFmpeg decoding.

	  Buildroot ships 4.3.7, whose AirPlay 2 buffered-audio path
	  stays silent with iOS 26 sources; release 5 handles them.

	  https://github.com/mikebrady/shairport-sync
```
